## Documentation/devicetree/bindings/clock/google,gs201-clock.yaml
```yaml
# SPDX-License-Identifier: (GPL-2.0-only OR BSD-2-Clause)
%YAML 1.2
---
$id: http://devicetree.org/schemas/clock/google,gs201-clock.yaml#
$schema: http://devicetree.org/meta-schemas/core.yaml#

title: Google GS201 top-level clock controller

maintainers:
  - Theo Paris <theo@theoparis.com>

description: |
  Google GS201 has separate clock management units (CMUs). CMU_TOP
  generates clocks for the other CMUs using PLLs, multiplexers, dividers,
  and gates. Its external reference clock is supplied by the board; on
  Pixel 7a this is 24.576 MHz.

  CMU_TOP also has an alternative boost input from CMU_APM. The boost
  input may be specified when that provider is available. Without it,
  boost multiplexers must remain on their CMU_TOP-derived inputs.

  Clock identifiers are defined in dt-bindings/clock/google,gs201.h.
  This binding describes CMU_TOP only; the other CMU interfaces are
  being reviewed separately.

properties:
  compatible:
    const: google,gs201-cmu-top

  reg:
    maxItems: 1

  "#clock-cells":
    const: 1

  clocks:
    minItems: 1
    items:
      - description: External reference clock
      - description: Alternative boost clock from CMU_APM

  clock-names:
    minItems: 1
    items:
      - const: oscclk
      - const: boost

required:
  - compatible
  - reg
  - "#clock-cells"
  - clocks
  - clock-names

additionalProperties: false

examples:
  - |
    #include <dt-bindings/clock/google,gs201.h>

    cmu_top: clock-controller@1e080000 {
        compatible = "google,gs201-cmu-top";
        reg = <0x1e080000 0x8000>;
        #clock-cells = <1>;
        clocks = <&ext_24_5m>;
        clock-names = "oscclk";
    };
...
```

## Documentation/devicetree/bindings/display/google,gs201-dpu.yaml
```yaml
# SPDX-License-Identifier: GPL-2.0-only OR BSD-2-Clause
%YAML 1.2
---
$id: http://devicetree.org/schemas/display/google,gs201-dpu.yaml#
$schema: http://devicetree.org/meta-schemas/core.yaml#

title: Google GS201 display processing unit

maintainers:
  - Theo Paris <theo@theoparis.com>

description: |
  Display controller of the Google Tensor G2 (GS201). The frontend (DPU
  in the CMU naming) contains the DMA and DPP layer channels, the backend
  (DISP) contains the DECON timing generator that feeds the DSI hosts.
  Each part is clocked from its own CMU.

properties:
  compatible:
    const: google,gs201-dpu

  reg:
    items:
      - description: DECON main registers
      - description: DPU DMA channel registers

  reg-names:
    items:
      - const: decon
      - const: dpp

  clocks:
    items:
      - description: DPU frontend DMA bus clock
      - description: DPU frontend DPP bus clock
      - description: DPU frontend register bridge clock
      - description: DISP backend DECON bus clock
      - description: DISP backend register bridge clock

  clock-names:
    items:
      - const: dma
      - const: dpp
      - const: dpu-apb
      - const: decon
      - const: disp-apb

  port:
    $ref: /schemas/graph.yaml#/properties/port
    description: Output to the DSI host.

required:
  - compatible
  - reg
  - reg-names
  - clocks
  - clock-names
  - port

additionalProperties: false

examples:
  - |
    #include <dt-bindings/clock/google,gs201.h>

    display-controller@1c240000 {
        compatible = "google,gs201-dpu";
        reg = <0x1c240000 0x6000>, <0x1c0b0000 0x6000>;
        reg-names = "decon", "dpp";
        clocks = <&cmu_dpu CLK_GOUT_DPU_DPUF_ACLK_DMA>,
                 <&cmu_dpu CLK_GOUT_DPU_DPUF_ACLK_DPP>,
                 <&cmu_dpu CLK_GOUT_DPU_AD_APB_DPU_DMA_PCLKM>,
                 <&cmu_disp CLK_GOUT_DISP_DPUB_ACLK_DECON>,
                 <&cmu_disp CLK_GOUT_DISP_AD_APB_DECON_MAIN_PCLKM>;
        clock-names = "dma", "dpp", "dpu-apb", "decon", "disp-apb";

        port {
            endpoint {
                remote-endpoint = <&dsim0_in>;
            };
        };
    };
```

## drivers/gpu/drm/gs201/Kconfig
```kconfig
# SPDX-License-Identifier: GPL-2.0-only
config DRM_GS201_DPU
	tristate "Google Tensor GS201 display controller (DECON/DPP)"
	depends on DRM && OF && (ARCH_EXYNOS || COMPILE_TEST)
	select DRM_CLIENT_SELECTION
	select DRM_GEM_DMA_HELPER
	select DRM_KMS_HELPER
	help
	  Display controller driver for the Google Tensor G2 (GS201), as found
	  in the Pixel 7 and 7a. Initially this adopts the DECON/DPP/DSIM
	  pipeline and command-mode panel left running by the bootloader.
```
